/dts-v1/;
/plugin/;

/ {
    overlay-name = "Disable Display Output Custom Echopilot Overlay";
	compatible = "nvidia,p3509-0000+p3767-0000\0nvidia,p3768-0000+p3767-0000\0nvidia,p3768-0000+p3767-0001\0nvidia,p3768-0000+p3767-0003\0nvidia,p3768-0000+p3767-0004\0nvidia,p3768-0000+p3767-0005";

    fragment@0 {
        target-path = "/display@13800000";
        __overlay__ {
            status = "disabled";
        };
    };
};
