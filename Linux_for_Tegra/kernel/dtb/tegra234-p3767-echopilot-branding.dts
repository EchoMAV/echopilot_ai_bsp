/dts-v1/;
/plugin/;

/ {
    overlay-name = "Custom Echopilot Branding Overlay";
    compatible = "nvidia,p3509-0000+p3767-0000\0nvidia,p3768-0000+p3767-0000\0nvidia,p3768-0000+p3767-0001\0nvidia,p3768-0000+p3767-0003\0nvidia,p3768-0000+p3767-0004\0nvidia,p3768-0000+p3767-0005";
    
    fragment@0 {
        target-path = "/";
        __overlay__ {
            model = "EchoPilot AI";
        };
    };
};
